/**
 * Auto-generated from project.json
 * @cliArgs --device "TM4C123x" --part "TM4C123GH6PM" --package "64 Pin QFP|16x16"
 * @versions {"tool":"1.27.1+4634"}
 */

const GPIO1 = scripting.addPeripheral("GPIO");
GPIO1["0"].io = "input";
GPIO1.$name = "BT_RX";
GPIO1["0"].$suggestSolution = "PA0";

const GPIO2 = scripting.addPeripheral("GPIO");
GPIO2["0"].io = "output";
GPIO2.$name = "BT_TX";
GPIO2["0"].$suggestSolution = "PA1";

const GPIO3 = scripting.addPeripheral("GPIO");
GPIO3["0"].io = "output";
GPIO3.$name = "M1_IN1";
GPIO3["0"].$suggestSolution = "PA2";

const GPIO4 = scripting.addPeripheral("GPIO");
GPIO4["0"].io = "output";
GPIO4.$name = "M1_IN2";
GPIO4["0"].$suggestSolution = "PA3";

const GPIO5 = scripting.addPeripheral("GPIO");
GPIO5["0"].io = "output";
GPIO5.$name = "M2_IN1";
GPIO5["0"].$suggestSolution = "PA4";

const GPIO6 = scripting.addPeripheral("GPIO");
GPIO6["0"].io = "output";
GPIO6.$name = "M2_IN2";
GPIO6["0"].$suggestSolution = "PA5";

const GPIO7 = scripting.addPeripheral("GPIO");
GPIO7["0"].io = "input";
GPIO7.$name = "LINE1";
GPIO7["0"].$suggestSolution = "PA6";

const GPIO8 = scripting.addPeripheral("GPIO");
GPIO8["0"].io = "input";
GPIO8.$name = "LINE2";
GPIO8["0"].$suggestSolution = "PA7";

const GPIO9 = scripting.addPeripheral("GPIO");
GPIO9["0"].io = "output";
GPIO9.$name = "M3_PWM";
GPIO9["0"].$suggestSolution = "PB0";

const GPIO10 = scripting.addPeripheral("GPIO");
GPIO10["0"].io = "output";
GPIO10.$name = "M4_PWM";
GPIO10["0"].$suggestSolution = "PB1";

const GPIO11 = scripting.addPeripheral("GPIO");
GPIO11["0"].io = "input";
GPIO11.$name = "I2C_SCL";
GPIO11["0"].$suggestSolution = "PB2";

const GPIO12 = scripting.addPeripheral("GPIO");
GPIO12["0"].io = "input";
GPIO12.$name = "I2C_SDA";
GPIO12["0"].$suggestSolution = "PB3";

const GPIO13 = scripting.addPeripheral("GPIO");
GPIO13["0"].io = "input";
GPIO13.$name = "BTN_UP";
GPIO13["0"].$suggestSolution = "PB4";

const GPIO14 = scripting.addPeripheral("GPIO");
GPIO14["0"].io = "input";
GPIO14.$name = "BTN_OK";
GPIO14["0"].$suggestSolution = "PB5";

const GPIO15 = scripting.addPeripheral("GPIO");
GPIO15["0"].io = "output";
GPIO15.$name = "M1_PWM";
GPIO15["0"].$suggestSolution = "PB6";

const GPIO16 = scripting.addPeripheral("GPIO");
GPIO16["0"].io = "output";
GPIO16.$name = "M2_PWM";
GPIO16["0"].$suggestSolution = "PB7";

const GPIO17 = scripting.addPeripheral("GPIO");
GPIO17["0"].io = "input";
GPIO17.$name = "M4_ENCA";
GPIO17["0"].$suggestSolution = "PC0";

const GPIO18 = scripting.addPeripheral("GPIO");
GPIO18["0"].io = "input";
GPIO18.$name = "M4_ENCB";
GPIO18["0"].$suggestSolution = "PC1";

const GPIO19 = scripting.addPeripheral("GPIO");
GPIO19["0"].io = "output";
GPIO19.$name = "M3_IN1";
GPIO19["0"].$suggestSolution = "PC4";

const GPIO20 = scripting.addPeripheral("GPIO");
GPIO20["0"].io = "input";
GPIO20.$name = "BTN_DN";
GPIO20["0"].$suggestSolution = "PC5";

const GPIO21 = scripting.addPeripheral("GPIO");
GPIO21["0"].io = "input";
GPIO21.$name = "LINE3";
GPIO21["0"].$suggestSolution = "PC6";

const GPIO22 = scripting.addPeripheral("GPIO");
GPIO22["0"].io = "output";
GPIO22.$name = "M3_IN2";
GPIO22["0"].$suggestSolution = "PC7";

const GPIO23 = scripting.addPeripheral("GPIO");
GPIO23["0"].io = "output";
GPIO23.$name = "M4_IN1";
GPIO23["0"].$suggestSolution = "PD0";

const GPIO24 = scripting.addPeripheral("GPIO");
GPIO24["0"].io = "output";
GPIO24.$name = "M4_IN2";
GPIO24["0"].$suggestSolution = "PD1";

const GPIO25 = scripting.addPeripheral("GPIO");
GPIO25["0"].io = "input";
GPIO25.$name = "M1_ENCA";
GPIO25["0"].$suggestSolution = "PD2";

const GPIO26 = scripting.addPeripheral("GPIO");
GPIO26["0"].io = "input";
GPIO26.$name = "M1_ENCB";
GPIO26["0"].$suggestSolution = "PD3";

const GPIO27 = scripting.addPeripheral("GPIO");
GPIO27["0"].io = "input";
GPIO27.$name = "M2_ENCA";
GPIO27["0"].$suggestSolution = "PD4";

const GPIO28 = scripting.addPeripheral("GPIO");
GPIO28["0"].io = "input";
GPIO28.$name = "M2_ENCB";
GPIO28["0"].$suggestSolution = "PD5";

const GPIO29 = scripting.addPeripheral("GPIO");
GPIO29["0"].io = "input";
GPIO29.$name = "M3_ENCA";
GPIO29["0"].$suggestSolution = "PD6";

const GPIO30 = scripting.addPeripheral("GPIO");
GPIO30["0"].io = "input";
GPIO30.$name = "M3_ENCB";
GPIO30["0"].$suggestSolution = "PD7";

const GPIO31 = scripting.addPeripheral("GPIO");
GPIO31["0"].io = "input";
GPIO31.$name = "BAT_ADC";
GPIO31["0"].$suggestSolution = "PE0";

const GPIO32 = scripting.addPeripheral("GPIO");
GPIO32["0"].io = "output";
GPIO32.$name = "DBG_TX";
GPIO32["0"].$suggestSolution = "PE1";

const GPIO33 = scripting.addPeripheral("GPIO");
GPIO33["0"].io = "input";
GPIO33.$name = "LINE4";
GPIO33["0"].$suggestSolution = "PE2";

const GPIO34 = scripting.addPeripheral("GPIO");
GPIO34["0"].io = "output";
GPIO34.$name = "BUZZER";
GPIO34["0"].$suggestSolution = "PE3";

const GPIO35 = scripting.addPeripheral("GPIO");
GPIO35["0"].io = "output";
GPIO35.$name = "ULTRA_TRIG";
GPIO35["0"].$suggestSolution = "PE4";

const GPIO36 = scripting.addPeripheral("GPIO");
GPIO36["0"].io = "input";
GPIO36.$name = "ULTRA_ECHO";
GPIO36["0"].$suggestSolution = "PE5";

const GPIO37 = scripting.addPeripheral("GPIO");
GPIO37["0"].io = "output";
GPIO37.$name = "RGB_LED";
GPIO37["0"].$suggestSolution = "PF4";
const GPIO38 = scripting.addPeripheral("GPIO");
GPIO38["0"].io = "input";
GPIO38.$name = "LINE5";
GPIO38["0"].$suggestSolution = "PC2";

const GPIO39 = scripting.addPeripheral("GPIO");
GPIO39["0"].io = "input";
GPIO39.$name = "LINE6";
GPIO39["0"].$suggestSolution = "PC3";
