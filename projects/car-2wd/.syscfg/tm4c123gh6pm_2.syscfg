/**
 * @cliArgs --device "TM4C123x" --part "TM4C123GH6PM" --package "64 Pin QFP|16x16" --product "TM4C123x@2.2.0.295"
 * @versions {"tool":"1.27.1+4634"}
 */

/**
 * These are the reserved peripherals and settings in this configuration
 */
const ADC1        = scripting.addPeripheral("ADC");
ADC1.$name        = "MyADC1";
ADC1.AIN2.$used   = false;
ADC1.AIN3.$used   = false;
ADC1.AIN8.$used   = false;
ADC1.AIN9.$used   = false;
ADC1.AIN10.$used  = false;
ADC1.AIN11.$used  = false;
const GPIO1       = scripting.addPeripheral("GPIO");
GPIO1["0"].io     = "output";
GPIO1.$name       = "M1_IN1";
const GPIO2       = scripting.addPeripheral("GPIO");
GPIO2["0"].io     = "output";
GPIO2.$name       = "M1_IN2";
const GPIO3       = scripting.addPeripheral("GPIO");
GPIO3["0"].io     = "output";
GPIO3.$name       = "M2_IN1";
const GPIO4       = scripting.addPeripheral("GPIO");
GPIO4["0"].io     = "output";
GPIO4.$name       = "M2_IN2";
const GPIO5       = scripting.addPeripheral("GPIO");
GPIO5.$name       = "M1_ENCA";
const GPIO6       = scripting.addPeripheral("GPIO");
GPIO6.$name       = "M1_ENCB";
const GPIO7       = scripting.addPeripheral("GPIO");
GPIO7.$name       = "M2_ENCA";
const GPIO8       = scripting.addPeripheral("GPIO");
GPIO8.$name       = "M2_ENCB";
const GPIO9       = scripting.addPeripheral("GPIO");
GPIO9.$name       = "LINE1";
const GPIO10      = scripting.addPeripheral("GPIO");
GPIO10.$name      = "LINE2";
const GPIO11      = scripting.addPeripheral("GPIO");
GPIO11.$name      = "LINE3";
const GPIO12      = scripting.addPeripheral("GPIO");
GPIO12.$name      = "LINE4";
const GPIO13      = scripting.addPeripheral("GPIO");
GPIO13.$name      = "LINE5";
const GPIO14      = scripting.addPeripheral("GPIO");
GPIO14.$name      = "BUTTON";
const GPIO15      = scripting.addPeripheral("GPIO");
GPIO15["0"].io    = "output";
GPIO15.$name      = "BUZZER";
const GPIO16      = scripting.addPeripheral("GPIO");
GPIO16["0"].io    = "output";
GPIO16.$name      = "RGB_LED";
const GPIO17      = scripting.addPeripheral("GPIO");
GPIO17["0"].io    = "output";
GPIO17.$name      = "ULTRA_TRIG";
const GPIO18      = scripting.addPeripheral("GPIO");
GPIO18.$name      = "ULTRA_ECHO";
const I2C1        = scripting.addPeripheral("I2C");
I2C1.$name        = "MyI2C0";
const PWM1        = scripting.addPeripheral("PWM");
PWM1.$name        = "MyPWM1";
PWM1.FAULT0.$used = false;
PWM1.PWM2.$used   = false;
PWM1.PWM3.$used   = false;
PWM1.PWM4.$used   = false;
PWM1.PWM5.$used   = false;
PWM1.PWM6.$used   = false;
PWM1.PWM7.$used   = false;
const QEI1        = scripting.addPeripheral("QEI");
QEI1.$name        = "MyQEI1";
QEI1.PHA.$assign  = "PC5";
QEI1.IDX.$used    = false;
QEI1.PHB.$assign  = "PC6";
const QEI2        = scripting.addPeripheral("QEI");
QEI2.$name        = "MyQEI2";
QEI2.PHA.$assign  = "PD6";
QEI2.IDX.$used    = false;
QEI2.PHB.$assign  = "PD7";
const SSI1        = scripting.addPeripheral("SSI");
SSI1.$name        = "MySSI1";
SSI1.RX.$assign   = "PA4";
SSI1.FSS.$assign  = "PA3";
SSI1.TX.$assign   = "PA5";
SSI1.CLK.$assign  = "PA2";
const UART1       = scripting.addPeripheral("UART");
UART1.$name       = "BLE_UART";
UART1.RX.$assign  = "PB0";
UART1.RTS.$used   = false;
UART1.TX.$assign  = "PB1";
UART1.CTS.$used   = false;
const UART2       = scripting.addPeripheral("UART");
UART2.$name       = "DEBG_UART";
UART2.$assign     = "UART7";
UART2.RX.$assign  = "PE0";
UART2.RTS.$used   = false;
UART2.TX.$assign  = "PE1";
UART2.CTS.$used   = false;

/**
 * Pinmux solution for unlocked pins/peripherals. This ensures that minor changes to the automatic solver in a future
 * version of the tool will not impact the pinmux you originally saw.  These lines can be completely deleted in order to
 * re-solve from scratch.
 */
ADC1.$suggestSolution        = "ADC1";
ADC1.AIN0.$suggestSolution   = "PE3";
ADC1.AIN1.$suggestSolution   = "PE2";
ADC1.AIN5.$suggestSolution   = "PD2";
ADC1.AIN4.$suggestSolution   = "PD3";
ADC1.AIN7.$suggestSolution   = "PD0";
ADC1.AIN6.$suggestSolution   = "PD1";
GPIO1["0"].$suggestSolution  = "PF4";
GPIO2["0"].$suggestSolution  = "PC7";
GPIO3["0"].$suggestSolution  = "PC4";
GPIO4["0"].$suggestSolution  = "PA0";
GPIO5["0"].$suggestSolution  = "PC5";
GPIO6["0"].$suggestSolution  = "PC6";
GPIO7["0"].$suggestSolution  = "PD6";
GPIO8["0"].$suggestSolution  = "PD7";
GPIO9["0"].$suggestSolution  = "PE3";
GPIO10["0"].$suggestSolution = "PE2";
GPIO11["0"].$suggestSolution = "PD2";
GPIO12["0"].$suggestSolution = "PD3";
GPIO13["0"].$suggestSolution = "PD0";
GPIO14["0"].$suggestSolution = "PD1";
GPIO15["0"].$suggestSolution = "PC0";
GPIO16["0"].$suggestSolution = "PE4";
GPIO17["0"].$suggestSolution = "PE5";
GPIO18["0"].$suggestSolution = "PD5";
I2C1.$suggestSolution        = "I2C0";
I2C1.SCL.$suggestSolution    = "PB2";
I2C1.SDA.$suggestSolution    = "PB3";
PWM1.$suggestSolution        = "PWM0";
PWM1.PWM0.$suggestSolution   = "PB6";
PWM1.PWM1.$suggestSolution   = "PB7";
QEI1.$suggestSolution        = "QEI1";
QEI2.$suggestSolution        = "QEI0";
SSI1.$suggestSolution        = "SSI0";
UART1.$suggestSolution       = "UART1";
